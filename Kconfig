## drivers/sensor/ec11_throttled/Kconfig
```kconfig
# Copyright (c) 2020 The ZMK Contributors
# SPDX-License-Identifier: MIT

menuconfig EC11_THROTTLED
    bool "EC11 Incremental Encoder Sensor (Rate-Limited)"
    default y
    depends on DT_HAS_CUSTOM_EC11_THROTTLED_ENABLED
    depends on GPIO
    help
      Enable rate-limited driver for EC11 incremental encoder sensors.
      This fork adds a configurable minimum interval between trigger
      events to prevent BLE queue accumulation on split peripherals.

if EC11_THROTTLED

choice EC11_THROTTLED_TRIGGER_MODE
    prompt "Trigger mode"
    default EC11_THROTTLED_TRIGGER_NONE
    help
      Specify the type of triggering to be used by the driver.

config EC11_THROTTLED_TRIGGER_NONE
    bool "No trigger"

config EC11_THROTTLED_TRIGGER_GLOBAL_THREAD
    bool "Use global thread"
    depends on GPIO
    select EC11_THROTTLED_TRIGGER

config EC11_THROTTLED_TRIGGER_OWN_THREAD
    bool "Use own thread"
    depends on GPIO
    select EC11_THROTTLED_TRIGGER

endchoice

config EC11_THROTTLED_TRIGGER
    bool

config EC11_THROTTLED_THREAD_PRIORITY
    int "Thread priority"
    depends on EC11_THROTTLED_TRIGGER_OWN_THREAD
    default 10
    help
      Priority of thread used by the driver to handle interrupts.

config EC11_THROTTLED_THREAD_STACK_SIZE
    int "Thread stack size"
    depends on EC11_THROTTLED_TRIGGER_OWN_THREAD
    default 1024
    help
      Stack size of thread used by the driver to handle interrupts.

config EC11_THROTTLED_MIN_INTERVAL_MS
    int "Minimum interval between trigger events (ms)"
    depends on EC11_THROTTLED_TRIGGER
    default 15
    help
      Events arriving faster than this interval are dropped.
      This prevents BLE queue accumulation on split peripherals
      during fast encoder rotation. Set to 0 to disable throttling.

endif # EC11_THROTTLED
```

## dts/bindings/sensor/custom,ec11-throttled.yaml
```yaml
description: |
  Rate-limited sensor driver for the Alps EC11 rotary encoder.
  Fork of alps,ec11 with configurable minimum trigger interval.

compatible: "custom,ec11-throttled"

properties:
  a-gpios:
    type: phandle-array
    required: true
    description: A pin for the encoder
  b-gpios:
    type: phandle-array
    required: true
    description: B pin for the encoder
  resolution:
    type: int
    description: Number of pulses per tick
    deprecated: true
    required: false
  steps:
    type: int
    description: Number of pulses in one full rotation
    required: false
```
